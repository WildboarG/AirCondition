/**
 * @file wifi6_led.c
 * @author your name (you@domain.com)
 * @brief
 * @version 0.1
 * @date 2023-10-30
 *
 * @copyright Copyright (c) 2023
 *
*/
#include <stdio.h>
#include <stdlib.h>
#include <string.h>
#include "FreeRTOS.h"
#include "task.h"
#include "user_airc.h"
#include "log.h"
#include "bflb_gpio.h"
#include "bflb_mtimer.h"
#include "bflb_timer.h"
#include "user_state.h"
#define DBG_TAG "LED"


struct bflb_device_s* gpio;
struct bflb_device_s*  timer0;

static xTaskHandle configNet_task;
static xTaskHandle configNet_stop;

bool ir_pin_status = false;

uint16_t rawData[15][139]={  //temp code
    {9024, 4436,  692, 1602,  694, 532,  668, 508,  694, 1604,  692, 1628,  668,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 510,  692},//16
    {9022, 4436,  690, 1606,  692, 508,  692, 508,  692, 1604,  692, 1604,  692,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 512,  690},//17
    {9026, 4434,  692, 1604,  692, 510,  692, 508,  692, 1606,  692, 1604,  692,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 510,  692},//18
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    {9024, 4458,  668, 1606,  692, 510,  690, 510,  692, 1604,  692, 1606,  688,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 510,  690}//30          
};

uint16_t off[139]= {9024, 4436,  688, 1606,  690, 534,  666, 512,  690, 512,  688, 1608,  690,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 512,  688};

void timer0_isr(int irq, void *arg)//timer0中端服务程序
{
    bool status = bflb_timer_get_compint_status(timer0, TIMER_COMP_ID_0);
    if (status) {
        bflb_timer_compint_clear(timer0, TIMER_COMP_ID_0);
        ir_pin_status ? bflb_gpio_set(gpio,IR) : bflb_gpio_reset(gpio,IR);
        ir_pin_status=!ir_pin_status;
    }
}

/**
 * @brief  configNET_start
 *
 * @param arg
*/
static void configNET_start(void* arg) // 
{
    while (1) {
        bflb_gpio_set(gpio, LED_CONFIG_NET);
        vTaskDelay(pdMS_TO_TICKS(200));
        bflb_gpio_reset(gpio, LED_CONFIG_NET);
        vTaskDelay(pdMS_TO_TICKS(200));
    }
}
/**
 * @brief
 *
*/
void ac_init(void)
{
    gpio = bflb_device_get_by_name("gpio");
    bflb_gpio_init(gpio, LED_CONFIG_NET, GPIO_OUTPUT | GPIO_PULLUP | GPIO_SMT_EN | GPIO_DRV_0);
    bflb_gpio_init(gpio, LED_DEV, GPIO_OUTPUT | GPIO_PULLUP | GPIO_SMT_EN | GPIO_DRV_0);
    bflb_gpio_init(gpio, IR, GPIO_OUTPUT | GPIO_PULLUP | GPIO_SMT_EN | GPIO_DRV_0); //IR 
    bflb_gpio_reset(gpio, LED_CONFIG_NET);
    bflb_gpio_reset(gpio, LED_DEV);
    bflb_gpio_reset(gpio, IR);  gpio = bflb_device_get_by_name("gpio");
    //初始化为3个端口

    struct bflb_timer_config_s cfg0;
    cfg0.counter_mode = TIMER_COUNTER_MODE_PROLOAD; 
    cfg0.clock_source = TIMER_CLKSRC_XTAL;//外部时钟为40
    cfg0.clock_div = 39; 
    cfg0.trigger_comp_id = TIMER_COMP_ID_0;
    cfg0.comp0_val = 13; 
    cfg0.preload_val = 0;    
 
 
    timer0 = bflb_device_get_by_name("timer0");
    bflb_timer_init(timer0, &cfg0);
    bflb_irq_attach(timer0->irq_num, timer0_isr, NULL);
    bflb_irq_enable(timer0->irq_num);
 

    xTaskCreate(configNET_start, "configNET_task", 1024, NULL, 2, &configNet_task);
    vTaskSuspend(configNet_task);
}
/**
 * @brief
 *
*/
static void led_configNET_start(void)
{
    if (configNet_task==NULL) {
        LOG_E("config NET task not created");
        return;
    }
    vTaskResume(configNet_task);
}

static void configNET_stop(void* arg)
{
    bflb_gpio_reset(gpio, LED_CONFIG_NET);
    bflb_gpio_set(gpio, LED_CONFIG_NET);
    vTaskDelay(pdMS_TO_TICKS(50));
    bflb_gpio_reset(gpio, LED_CONFIG_NET);
    vTaskDelay(pdMS_TO_TICKS(50));
    bflb_gpio_set(gpio, LED_CONFIG_NET);
    vTaskDelay(pdMS_TO_TICKS(50));
    bflb_gpio_reset(gpio, LED_CONFIG_NET);
    vTaskDelete(NULL);
}


/**
 * @brief
 *
*/
static void led_configNET_stop(void)
{
    if (configNet_task==NULL) {
        LOG_E("config NET task not created");
        return;
    }
    vTaskSuspend(configNet_task);
    xTaskCreate(configNET_stop, "configNET_task", 1024, NULL, 4, &configNet_stop);
}

static void configNET_server_CNT(void* arg) //mqtt连接成功
{
    bflb_gpio_reset(gpio, LED_CONFIG_NET);
    bflb_gpio_set(gpio, LED_CONFIG_NET);
    vTaskDelay(pdMS_TO_TICKS(2000));
    bflb_gpio_reset(gpio, LED_CONFIG_NET);
    vTaskDelete(NULL);
}

void led_indicator_change(int led_state)
{
    user_state_t state = led_state;
    switch (state)
    {
        case STATE_WIFI_CONNECTING:
            /* code */
            led_configNET_start();
            break;
        case STATE_WIFI_CONNECTED_OK:
            led_configNET_stop();
            break;
        case STATE_MQTT_SERVER_CONENCT_OK:
        {
            //创建任务，常亮2S 灯
            xTaskCreate(configNET_server_CNT, "server led", 1024, NULL, 4, NULL);
        }
        break;
        default:
            break;
    }
}

void led_dev_open(int* led_state)
{
    bflb_gpio_set(gpio, LED_DEV);
    *led_state = true;
}

void led_dev_cloes(int* led_state)
{
    bflb_gpio_reset(gpio, LED_DEV);
    *led_state = false;
}

void ctlAC(int status){
    printf("temp : %d\r\n",status);
    Send_IR(rawData[status - 16],139);
}


void Send_IR(uint16_t *buf,uint8_t len)
{
   // printf("Sending IR code...\n");
    for (uint16_t i = 0; i < len; i++) {
        if (i%2==0) {
            bflb_timer_start(timer0);     // 启用38kHz载波
            bflb_mtimer_delay_us(buf[i]); // 高电平（脉冲时间）
            bflb_timer_stop(timer0);      // 停止38kHz载波

        } else {
            bflb_gpio_reset(gpio, IR);
            bflb_mtimer_delay_us(buf[i]); // 低电平（空闲时间）
        }
    }
}